## package/vdr/Config.in
```kconfig
config BR2_PACKAGE_VDR
        bool "vdr"
        select BR2_PACKAGE_LIBCAP
        select BR2_PACKAGE_JPEG_LIBRARY
        select BR2_PACKAGE_FONTCONFIG
        select BR2_PACKAGE_FREETYPE
        select BR2_PACKAGE_GETTEXT
        help
            The Video Disk Recorder

            http://www.tvdr.de

if BR2_PACKAGE_VDR
menu "VDR plugins selection"
config BR2_PACKAGE_VDR_RPIHDDEVICE
        bool "vdr-rpihddevice"
        select BR2_PACKAGE_VCOS
        select BR2_PACKAGE_FFMPEG
	select BR2_PACKAGE_MESA
        default n
        help
            rpihddevice plugin

config BR2_PACKAGE_VDR_STREAMDEV
        bool "vdr-streamdev"
        default n
        help
            streamdev plugin

config BR2_PACKAGE_VDR_SUSPENDOUTPUT
        bool "vdr-suspendoutput"
        default n
        help
            suspendoutput plugin

config BR2_PACKAGE_VDR_REMOTETIMERS
        bool "vdr-remotetimers"
	select BR2_PACKAGE_VDR_SVDRPSERVICE
        default n
        help
            remotetimers plugin

config BR2_PACKAGE_VDR_SVDRPSERVICE
        bool "vdr-svdrpservice"
        default n
        help
            remotetimers plugin

config BR2_PACKAGE_VDR_SKINDESIGNER
        bool "vdr-skindesigner"
	select BR2_PACKAGE_CAIRO
	select BR2_PACKAGE_LIBXML2
	select BR2_PACKAGE_LIBRSVG
	select BR2_PACKAGE_LIBCURL
        default n
        help
            skindesigner plugin

config BR2_PACKAGE_VDR_CECREMOTE
        bool "vdr-cecremote"
	select BR2_PACKAGE_LIBCEC
#	select BR2_PACKAGE_LIBPUGIXML
        default n
        help
            cec plugin


endmenu
endif
```
